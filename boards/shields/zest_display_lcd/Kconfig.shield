## boards/shields/zest_display_lcd/Kconfig.shield
```kconfig
# Copyright (c) 2024 CATIE
# SPDX-License-Identifier: Apache-2.0

config SHIELD_ZEST_DISPLAY_LCD
	def_bool $(shields_list_contains,zest_display_lcd)
```
